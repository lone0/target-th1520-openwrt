## thead/licheepi4a_defconfig
```kconfig
CONFIG_TARGET_thead=y
CONFIG_TARGET_thead_th1520=y
CONFIG_TARGET_thead_th1520_DEVICE_sipeed_lpi4a=y
# CONFIG_KERNEL_WERROR is not set
CONFIG_TARGET_EXT4_BLOCKSIZE=4096
CONFIG_TARGET_EXT4_BLOCKSIZE_4K=y
CONFIG_TARGET_EXT4_JOURNAL=y
CONFIG_TARGET_EXT4_RESERVED_PCT=0
CONFIG_TARGET_KERNEL_PARTSIZE=32
CONFIG_TARGET_ROOTFS_EXT4FS=y
# CONFIG_TARGET_ROOTFS_SQUASHFS is not set
# CONFIG_TARGET_ROOTFS_TARGZ is not set
# CONFIG_TARGET_IMAGES_GZIP is not set
```
